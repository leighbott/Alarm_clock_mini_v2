## sdkconfig.defaults
```kconfig
# OPI PSRAM configuration for ESP32-S3 N16R8
# These settings cannot be applied via build_flags — they must live here.
CONFIG_ESP32S3_SPIRAM_SUPPORT=y
CONFIG_SPIRAM_MODE_OCT=y
CONFIG_SPIRAM_SPEED_80M=y
CONFIG_SPIRAM_FETCH_INSTRUCTIONS=y
CONFIG_SPIRAM_RODATA=y
```
